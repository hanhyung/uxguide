// 7세그먼트에 표시할 숫자를 배열로 준비해놓습니다. // 0은 끄는 것이고, 1은 켜는 것입니다. byte digits[10][7] =
byte digits[10][7] =
{ 
    { 0,0,0,0,0,0,1 }, // 0
    { 1,0,0,1,1,1,1 }, // 1
    { 0,0,1,0,0,1,0 }, // 2
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    { 0,0,0,1,1,0,0 } // 9
};
void setup(){
// 2~9번 핀들을 모두 출력 모드로 설정합니다. 
  for(int i=2;i<10;i++){
    pinMode(i, OUTPUT);
  }
    digitalWrite(9, HIGH);
  // DP, 바로 점에 해당하는 부분을 켜줍니다. 
}

void loop(){
    // 10번 반복하는 반복문을 만듭니다. // 0에서 9까지 반복합니다.
    for(int i=0;i<10;i++){ 
          delay(1000);// 1초 멈춥니다.
          displayDigit(i);        // 7세그먼트에 숫자를 표시합니다. 
    }
 }
  
  
// 숫자를 표시하기 위해 만든 함수입니다. 
void displayDigit(int num){
    int pin = 2;// 핀이 2번부터 시작하기 때문에// 핀 번호를 맞춰주기 위해 2라는 값을 pin이란 변수를 선언했습니다. 
    for(int i=0;i<7;i++){
        digitalWrite(pin+i, digits[num][i]);    // // 앞서 준비한 배열에서 값을 불러와서 숫자를 7세그먼트에 표시합니다. 
  }
}
